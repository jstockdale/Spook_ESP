## ghost_esp_c6/main/Kconfig.projbuild
```kconfig
menu "Spook ESP Configuration"

    config GHOST_SDIO_ENABLED
        bool "Enable SDIO slave transport to P4"
        default y
        help
            Enable SDIO slave interface for communication with the ESP32-P4 host.

    config GHOST_UART_FALLBACK
        bool "Enable UART fallback console"
        default y
        help
            Enable UART0 as a fallback command interface for standalone debugging.

    menu "Sleep / Power Configuration"
        config GHOST_WAKE_GPIO
            int "GPIO pin for external wake (C6_WAKEUP from P4)"
            default 2
            help
                GPIO connected to the C6_WAKEUP signal from the P4's GPIO expander.
                On T-Display-P4: module pin 5 = C6 GPIO2.
                Used as wake source for both light sleep and deep sleep.
                Set to -1 to disable GPIO wake (timer-only wake).

        config GHOST_SLEEP_FLUSH_TIMEOUT_MS
            int "Timeout (ms) to flush pending data before sleep"
            default 500
            help
                How long to wait for pending SDIO sends and PCAP writes
                to complete before entering sleep.
    endmenu

    menu "SD Card Configuration"
        config GHOST_SD_ENABLED
            bool "Enable SD card support"
            default n

        config GHOST_SD_SPI_CS_PIN
            int "SD Card SPI CS pin"
            default 4
            depends on GHOST_SD_ENABLED

        config GHOST_SD_SPI_CLK_PIN
            int "SD Card SPI CLK pin"
            default 18
            depends on GHOST_SD_ENABLED

        config GHOST_SD_SPI_MISO_PIN
            int "SD Card SPI MISO pin"
            default 19
            depends on GHOST_SD_ENABLED

        config GHOST_SD_SPI_MOSI_PIN
            int "SD Card SPI MOSI pin"
            default 23
            depends on GHOST_SD_ENABLED
    endmenu

    menu "GPS Configuration"
        config GHOST_GPS_ENABLED
            bool "Enable GPS module"
            default n

        config GHOST_GPS_UART_NUM
            int "GPS UART number"
            default 1
            depends on GHOST_GPS_ENABLED

        config GHOST_GPS_TX_PIN
            int "GPS TX pin (ESP RX)"
            default 5
            depends on GHOST_GPS_ENABLED

        config GHOST_GPS_RX_PIN
            int "GPS RX pin (ESP TX)"
            default 4
            depends on GHOST_GPS_ENABLED
    endmenu

    menu "Network Pipe Configuration"
        config GHOST_NET_PIPE_ENABLED
            bool "Enable network pipe for P4 internet access"
            default y
            help
                Allow P4 to send/receive TCP/UDP traffic through the C6's WiFi connection.

        config GHOST_NET_PIPE_PORT
            int "Network pipe control port (internal)"
            default 7777
            depends on GHOST_NET_PIPE_ENABLED
    endmenu

    config GHOST_MAX_SCAN_RESULTS
        int "Maximum WiFi scan results to store"
        default 64

    config GHOST_MAX_BLE_DEVICES
        int "Maximum BLE devices to track"
        default 64

    config GHOST_PCAP_BUFFER_SIZE
        int "PCAP write buffer size (bytes)"
        default 4096

endmenu
```

## ghost_esp_c6/sdkconfig.defaults
```kconfig
# Target
CONFIG_IDF_TARGET="esp32c6"

# Flash
CONFIG_ESPTOOLPY_FLASHMODE_DIO=y
CONFIG_ESPTOOLPY_FLASHFREQ_80M=y
CONFIG_ESPTOOLPY_FLASHSIZE_4MB=y

# Partition table
CONFIG_PARTITION_TABLE_CUSTOM=y
CONFIG_PARTITION_TABLE_CUSTOM_FILENAME="partitions.csv"

# CPU
CONFIG_ESP_DEFAULT_CPU_FREQ_MHZ_160=y

# Compiler
CONFIG_COMPILER_OPTIMIZATION_SIZE=y

# Bluetooth - NimBLE
CONFIG_BT_ENABLED=y
CONFIG_BT_NIMBLE_ENABLED=y
CONFIG_BT_NIMBLE_MAX_CONNECTIONS=3
CONFIG_BT_NIMBLE_ROLE_CENTRAL=y
CONFIG_BT_NIMBLE_ROLE_PERIPHERAL=y
CONFIG_BT_NIMBLE_ROLE_BROADCASTER=y
CONFIG_BT_NIMBLE_ROLE_OBSERVER=y
CONFIG_BT_NIMBLE_SECURITY_ENABLE=y
CONFIG_BT_NIMBLE_SM_LEGACY=y
CONFIG_BT_NIMBLE_SM_SC=y
CONFIG_BT_NIMBLE_50_FEATURE_SUPPORT=y
CONFIG_BT_NIMBLE_LL_CFG_FEAT_LE_2M_PHY=y
CONFIG_BT_NIMBLE_LL_CFG_FEAT_LE_CODED_PHY=y
CONFIG_BT_NIMBLE_ATT_PREFERRED_MTU=256
CONFIG_BT_NIMBLE_HOST_TASK_STACK_SIZE=4096
CONFIG_BT_LE_DFT_TX_POWER_LEVEL_P9=y

# WiFi
CONFIG_ESP_WIFI_ENABLED=y
CONFIG_ESP_WIFI_STATIC_RX_BUFFER_NUM=10
CONFIG_ESP_WIFI_DYNAMIC_RX_BUFFER_NUM=32
CONFIG_ESP_WIFI_DYNAMIC_TX_BUFFER=y
CONFIG_ESP_WIFI_DYNAMIC_TX_BUFFER_NUM=32
CONFIG_ESP_WIFI_AMPDU_TX_ENABLED=y
CONFIG_ESP_WIFI_TX_BA_WIN=6
CONFIG_ESP_WIFI_AMPDU_RX_ENABLED=y
CONFIG_ESP_WIFI_RX_BA_WIN=6
CONFIG_ESP_WIFI_NVS_ENABLED=y
CONFIG_ESP_WIFI_SOFTAP_BEACON_MAX_LEN=752
CONFIG_ESP_WIFI_MGMT_SBUF_NUM=32
CONFIG_ESP_WIFI_IRAM_OPT=y
CONFIG_ESP_WIFI_EXTRA_IRAM_OPT=y
CONFIG_ESP_WIFI_RX_IRAM_OPT=y
CONFIG_ESP_WIFI_ENABLE_WPA3_SAE=y
CONFIG_ESP_WIFI_SOFTAP_SAE_SUPPORT=y
CONFIG_ESP_WIFI_SOFTAP_SUPPORT=y
CONFIG_ESP_WIFI_ENTERPRISE_SUPPORT=y

# IEEE 802.15.4
CONFIG_IEEE802154_ENABLED=y
CONFIG_IEEE802154_RX_BUFFER_SIZE=20

# Coexistence
CONFIG_ESP_COEX_ENABLED=y
CONFIG_ESP_COEX_SW_COEXIST_ENABLE=y

# LWIP
CONFIG_LWIP_MAX_SOCKETS=10
CONFIG_LWIP_SO_REUSE=y
CONFIG_LWIP_SO_REUSE_RXTOALL=y
CONFIG_LWIP_IP4_FRAG=y
CONFIG_LWIP_DHCPS=y
CONFIG_LWIP_MAX_RAW_PCBS=16
CONFIG_LWIP_TCPIP_TASK_STACK_SIZE=3072

# HTTPD
CONFIG_HTTPD_MAX_REQ_HDR_LEN=512
CONFIG_HTTPD_MAX_URI_LEN=512

# FAT filesystem for SD card
CONFIG_FATFS_LFN_HEAP=y
CONFIG_FATFS_SECTOR_4096=y
CONFIG_FATFS_CODEPAGE_437=y
CONFIG_FATFS_MAX_LFN=255
CONFIG_FATFS_VOLUME_COUNT=2

# NVS
# CONFIG_NVS_ENCRYPTION is not set

# ESP System
CONFIG_ESP_MAIN_TASK_STACK_SIZE=4096
CONFIG_ESP_SYSTEM_EVENT_QUEUE_SIZE=32
CONFIG_ESP_TASK_WDT_EN=y
CONFIG_ESP_TASK_WDT_TIMEOUT_S=10

# Console - UART for debug, USB Serial/JTAG as secondary
CONFIG_ESP_CONSOLE_UART_DEFAULT=y
CONFIG_ESP_CONSOLE_SECONDARY_USB_SERIAL_JTAG=y
CONFIG_ESP_CONSOLE_UART_BAUDRATE=115200

# Log level
CONFIG_LOG_DEFAULT_LEVEL_WARN=y

# mbedTLS
CONFIG_MBEDTLS_HARDWARE_AES=y
CONFIG_MBEDTLS_HARDWARE_MPI=y
CONFIG_MBEDTLS_HARDWARE_SHA=y
CONFIG_MBEDTLS_HARDWARE_ECC=y
CONFIG_MBEDTLS_CERTIFICATE_BUNDLE=y
CONFIG_MBEDTLS_CERTIFICATE_BUNDLE_DEFAULT_FULL=y

# FreeRTOS
CONFIG_FREERTOS_HZ=100
CONFIG_FREERTOS_UNICORE=y
CONFIG_FREERTOS_CHECK_STACKOVERFLOW_CANARY=y

# PHY
CONFIG_ESP_PHY_CALIBRATION_AND_DATA_STORAGE=y
CONFIG_ESP_PHY_MAX_WIFI_TX_POWER=20

# Power management
CONFIG_PM_SLP_DEFAULT_PARAMS_OPT=y
```
